
#define	__EXT_NTC_
#include "Globals.h"

///////////////////////////////////////////////////////////////////////////////////////////////////
#define cnNTCResMin					48			// 高于200℃的电阻值
#define cnNTCResMax					170000		// 低于-30℃的电阻值
#define cnCheckNTCTempHLT			(500/cnTBaseT_10ms)		// 检测NTC超高温/超低温判断时间

#ifdef cnNTCModel_XF_Fast
#define cnBoilerNTCResTabNum		126
static uint16_t ROM_DATA BoilerNTC_Res_Tab[cnBoilerNTCResTabNum] = {
	32701,	31076,	29541,	28090,	26720,	25424,	24198,	23039,	21942,	20903,	// 0~9
	19920,	18988,	18105,	17268,	16475,	15722,	15008,	14331,	13688,	13077,	// 10~19
	12497,	11946,	11422,	10924,	10450,	10000,	9571,	9163,	8774,	8405, 	// 20~29
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	372,	362,	352,	343,	334,	325										// 120~125
};

#elif (defined(cnNTCModel_KonTan_TK_S))
#define cnBoilerNTCResTabNum		200
static uint16_t ROM_DATA BoilerNTC_Res_Tab[cnBoilerNTCResTabNum] = {
	30903,	29366,	27914,	26542,	25246,	24021,	22862,	21766,	20729,	19748,
	18818,	17938,	17103,	16313,	15563,	14852,	14177,	13537,	12930,	12353,
	11805,	11284,	10789,	10319,	9871,	9446,	9040,	8651,	8281,	7928,
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	67,		66,		64,		63,		62,		60,		59,		58,		57,		56
};

#else
#define cnBoilerNTCResTabNum		200
static uint16_t ROM_DATA BoilerNTC_Res_Tab[cnBoilerNTCResTabNum] = {
	31769,	30160,	28642,	27209,	25856,	24580,	23375,	22237,	21164,	20150,	// 0~9
	19192,	18288,	17434,	16628,	15866,	15146,	14466,	13823,	13215,	12641,	// 10~19
	12098,	11585,	11100,	10641,	10207,	9796,	9376,	8976,	8596,	8233,	// 20~29
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	66,		65,		64,		62,		61,		60,		59,		58,		56,		55		// 190~199
};

#endif

///////////////////////////////////////////////////////////////////////////////////////////////////
/*
		5V
		---
		 |
		|-|
		| | Rx
		|_|
		 |		_____
		 |------|	|----------------> ADC_Port
		 |		-----		 |
		|-|		  2K		 |
		| |	10K				---
		|_|					--- 100nF
		 |					 |
		 |--------------------
		---
		 -  GND

电压转换为电阻值的计算方法:
	 10000 				    Vb5.0 * Vad
--------------- * Va5.0  =  -----------
  (Rx+10000)	   			  4095

Rx	: 为待求的NTC电阻值，单位欧姆
Vad : 为AD转换器的读数，AD的基准电压为Vb5.0为5V，分辨率为12bit.
Va5.0 : 用于NTC工作电压5V，请参考原理图
10000 : 分压电阻的阻值,单位欧姆。
最后的欧姆结果再除以10，缩小10倍，以适用上面数组的电阻值。

整合之后的公式: Rx = 1000*(4095-Vad)/Vad;
*/


Temp_NTC_t RAM_xDATA tempNTC;

void NTC_Init(void)
{
	GetADC_Init();
	
	tempNTC.NTCErr = cnNTC_Err_OK;
	tempNTC.TempHighCnt = 0;
	tempNTC.TempLowCnt = 0;
	tempNTC.temp = 0xFF;
}

static uint8_t Get_NTC_averTemp(uint8_t temp)
{
	uint8_t i;
	
	if(tempNTC.temp == 0xFF)
		sub_memset((uint8_t *)tempNTC.tempBuf, temp, cnGetNTCNum);
	else
	{
		for(i=1; i<cnGetNTCNum; i++)
			tempNTC.tempBuf[cnGetNTCNum-i] = tempNTC.tempBuf[cnGetNTCNum-1-i];
		tempNTC.tempBuf[0] = temp;
	}

	temp = sub_getchecksum_u16((uint8_t *)tempNTC.tempBuf, cnGetNTCNum) / cnGetNTCNum;
	return temp;
}

void NTC_Run_Task(void)
{
	uint8_t temp;
	uint16_t Vad;
	uint32_t Rx;

//return;

	// 读取ADC值
	Vad = Read_BoilerNTC_ADC();
	if(Vad == 0)
	{
		tempNTC.NTCErr = cnNTC_Err_RxShort;
		tempNTC.temp = 0;
		return;
	}
	if(Vad >= 4095)
	{
		tempNTC.NTCErr = cnNTC_Err_RxOpen;
		tempNTC.temp = 0;
		return;
	}
	
	// 转换为电阻
	Rx = 1000UL * (4095 - Vad) / Vad;
	
	// 转换为温度值
	if((Rx >= BoilerNTC_Res_Tab[cnBoilerNTCResTabNum-1]) && (Rx <= BoilerNTC_Res_Tab[0]))
	{
		for(temp=0; temp<(cnBoilerNTCResTabNum-1); temp++)
		{
			if((Rx <= BoilerNTC_Res_Tab[temp]) && (Rx > BoilerNTC_Res_Tab[temp+1]))
				break;
		}

		tempNTC.NTCErr = cnNTC_Err_OK;
		tempNTC.TempLowCnt = 0;
		tempNTC.TempHighCnt = 0;
	}
	else
	{
		if(Rx < BoilerNTC_Res_Tab[cnBoilerNTCResTabNum-1])
		{
			temp = cnBoilerNTCResTabNum - 1;
			if((++tempNTC.TempHighCnt) > cnCheckNTCTempHLT)
			{
				tempNTC.TempHighCnt = cnCheckNTCTempHLT;
				tempNTC.NTCErr = cnNTC_Err_TempHigh;
			}
		}
		else
		{
			temp = 0;
			if((++tempNTC.TempLowCnt) > cnCheckNTCTempHLT)
			{
				tempNTC.TempLowCnt = cnCheckNTCTempHLT;
				tempNTC.NTCErr = cnNTC_Err_TempLow;
			}
		}
	}

	tempNTC.temp = Get_NTC_averTemp(temp);
}		

